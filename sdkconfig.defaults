## sdkconfig.defaults
```kconfig
CONFIG_ESP_MAIN_TASK_STACK_SIZE=32768
CONFIG_ESP_MAIN_TASK_AFFINITY_CPU1=y
CONFIG_FREERTOS_HZ=1000

CONFIG_BT_ENABLED=y
CONFIG_BT_BLE_ENABLED=y
CONFIG_BT_BLUEDROID_ENABLED=n
CONFIG_BT_NIMBLE_ENABLED=y
CONFIG_BT_NIMBLE_NVS_PERSIST=y
CONFIG_BT_NIMBLE_MAX_CONNECTIONS=2
CONFIG_BT_NIMBLE_L2CAP_COC_MAX_NUM=2
CONFIG_BT_NIMBLE_50_FEATURE_SUPPORT=n
CONFIG_BT_NIMBLE_HOST_ALLOW_CONNECT_WITH_SCAN=y
CONFIG_BT_NIMBLE_PINNED_TO_CORE_0=y
CONFIG_BT_NIMBLE_HOST_TASK_STACK_SIZE=12288
CONFIG_BT_NIMBLE_MEM_ALLOC_MODE_EXTERNAL=y
CONFIG_BT_NIMBLE_MAX_CCCDS=2
CONFIG_BT_NIMBLE_SECURITY_ENABLE=n
CONFIG_BT_NIMBLE_SM_SC=n
CONFIG_BT_NIMBLE_ATT_PREFERRED_MTU=23
CONFIG_BT_NIMBLE_GATT_SERVER=n
CONFIG_BT_NIMBLE_MSYS_1_BLOCK_COUNT=6
CONFIG_BT_NIMBLE_MSYS_2_BLOCK_COUNT=12
CONFIG_BT_NIMBLE_TRANSPORT_ACL_FROM_LL_COUNT=12
CONFIG_BT_NIMBLE_TRANSPORT_EVT_COUNT=15
CONFIG_BT_NIMBLE_ATT_MAX_PREP_ENTRIES=15
CONFIG_BTDM_CTRL_MODE_BLE_ONLY=y
CONFIG_BTDM_CTRL_MODE_BR_EDR_ONLY=n
CONFIG_BTDM_CTRL_MODE_BTDM=n
CONFIG_BTDM_CTRL_BLE_MAX_CONN=2
CONFIG_BT_NIMBLE_LOG_LEVEL_WARNING=y

CONFIG_PTHREAD_TASK_STACK_SIZE_DEFAULT=3072

CONFIG_SPIRAM=y
CONFIG_SPIRAM_MODE_OCT=y
CONFIG_SPIRAM_SPEED_80M=y
CONFIG_SPIRAM_USE_CAPS_ALLOC=y
CONFIG_SPIRAM_IGNORE_NOTFOUND=y

CONFIG_ESP_COEX_SW_COEXIST_ENABLE=n

CONFIG_SPI_FLASH_VENDOR_XMC_SUPPORTED=n
CONFIG_SPI_FLASH_VENDOR_GD_SUPPORTED=n
CONFIG_SPI_FLASH_VENDOR_ISSI_SUPPORTED=n
CONFIG_SPI_FLASH_VENDOR_MXIC_SUPPORTED=n
CONFIG_SPI_FLASH_VENDOR_WINBOND_SUPPORTED=n
CONFIG_SPI_FLASH_VENDOR_BOYA_SUPPORTED=n
CONFIG_SPI_FLASH_VENDOR_TH_SUPPORTED=n
CONFIG_SPI_FLASH_SUPPORT_ISSI_CHIP=n
CONFIG_SPI_FLASH_SUPPORT_MXIC_CHIP=n
CONFIG_SPI_FLASH_SUPPORT_GD_CHIP=n
CONFIG_SPI_FLASH_SUPPORT_WINBOND_CHIP=n
CONFIG_SPI_FLASH_SUPPORT_BOYA_CHIP=n
CONFIG_SPI_FLASH_SUPPORT_TH_CHIP=n
CONFIG_SPI_FLASH_ENABLE_ENCRYPTED_READ_WRITE=n
CONFIG_SPI_FLASH_ROM_IMPL=y
CONFIG_SPI_FLASH_YIELD_DURING_ERASE=n

CONFIG_HEAP_PLACE_FUNCTION_INTO_FLASH=y
CONFIG_FREERTOS_PLACE_FUNCTIONS_INTO_FLASH=y
CONFIG_RINGBUF_PLACE_FUNCTIONS_INTO_FLASH=y
CONFIG_RINGBUF_PLACE_ISR_FUNCTIONS_INTO_FLASH=y

CONFIG_HAL_SYSTIMER_USE_ROM_IMPL=y
CONFIG_HAL_WDT_USE_ROM_IMPL=y
CONFIG_COMPILER_OPTIMIZATION_SIZE=y
#CONFIG_COMPILER_OPTIMIZATION_ASSERTIONS_DISABLE=y

CONFIG_SPI_MASTER_ISR_IN_IRAM=n
CONFIG_SPI_SLAVE_ISR_IN_IRAM=n

#CONFIG_BT_CTRL_RUN_IN_FLASH_ONLY=y

CONFIG_FREERTOS_USE_TRACE_FACILITY=y
CONFIG_FREERTOS_GENERATE_RUN_TIME_STATS=y

CONFIG_ESPTOOLPY_FLASHSIZE="8MB"

CONFIG_ESP_COEX_ENABLED=n
CONFIG_ESP_COEX_SW_COEXIST_ENABLE=n

CONFIG_ETH_ENABLED=n

CONFIG_ESP_WIFI_ENABLED=n

CONFIG_ESP_GDBSTUB_SUPPORT_TASKS=n
CONFIG_ESP_NETIF_REPORT_DATA_TRAFFIC=n

CONFIG_PM_ENABLE=n
CONFIG_PM_POWER_DOWN_CPU_IN_LIGHT_SLEEP=n

CONFIG_APP_COMPILE_TIME_DATE=n
CONFIG_ESP_ERR_TO_NAME_LOOKUP=n

CONFIG_BOOTLOADER_LOG_LEVEL_NONE=y
CONFIG_BOOTLOADER_COMPILER_OPTIMIZATION_SIZE=y

#CONFIG_HAL_ASSERTION_DISABLE=y

CONFIG_VFS_SUPPORT_TERMIOS=n

CONFIG_LIBC_NEWLIB_NANO_FORMAT=y
CONFIG_NEWLIB_NANO_FORMAT=y
CONFIG_LIBC_STDIN_LINE_ENDING_CRLF=n
CONFIG_LIBC_STDOUT_LINE_ENDING_CRLF=n

CONFIG_FREERTOS_TIMER_SERVICE_TASK_NAME="timersvc"

CONFIG_LWIP_DHCPS=n
CONFIG_LWIP_IPV6=n
CONFIG_MBEDTLS_EXTERNAL_MEM_ALLOC=y
CONFIG_MBEDTLS_SSL_KEEP_PEER_CERTIFICATE=n
CONFIG_MBEDTLS_CERTIFICATE_BUNDLE=n
CONFIG_MBEDTLS_CERTIFICATE_BUNDLE_DEFAULT_NONE=y
CONFIG_MBEDTLS_PKCS7_C=n

CONFIG_STDATOMIC_S32C1I_SPIRAM_WORKAROUND=y

CONFIG_ESP_CONSOLE_UART_BAUDRATE=576000
```
